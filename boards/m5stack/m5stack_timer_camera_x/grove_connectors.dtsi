/*
 * Copyright The Zephyr Project Contributors
 *
 * SPDX-License-Identifier: Apache-2.0
 */

/ {
	grove_header: grove_header {
		compatible = "grove-header";
		#gpio-cells = <2>;
		gpio-map-mask = <0xffffffff 0xffffffc0>;
		gpio-map-pass-thru = <0 0x3f>;
		gpio-map = <0 0 &gpio0 13 0>,    /* D0/SCL */
			   <1 0 &gpio0 4 0>;     /* D1/SDA */
	};
};

grove_i2c: &i2c1 {};
