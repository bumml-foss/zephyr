## boards/m5stack/m5stack_timer_camera_x/Kconfig.defconfig
```kconfig
# M5Stack Timer Camera X board configuration

# Copyright The Zephyr Project Contributors
# SPDX-License-Identifier: Apache-2.0

if BOARD_M5STACK_TIMER_CAMERA_X_ESP32_PROCPU

config ESP_SPIRAM
	default y if !MCUBOOT

choice SPIRAM_TYPE
	default SPIRAM_TYPE_ESPPSRAM64
endchoice

endif # BOARD_M5STACK_TIMER_CAMERA_X_ESP32_PROCPU
```

## boards/m5stack/m5stack_timer_camera_x/Kconfig.m5stack_timer_camera_x
```kconfig
# Copyright The Zephyr Project Contributors
# SPDX-License-Identifier: Apache-2.0

config BOARD_M5STACK_TIMER_CAMERA_X
	select SOC_ESP32
	select SOC_ESP32_PROCPU if BOARD_M5STACK_TIMER_CAMERA_X_ESP32_PROCPU
	select SOC_ESP32_APPCPU if BOARD_M5STACK_TIMER_CAMERA_X_ESP32_APPCPU
```

## boards/m5stack/m5stack_timer_camera_x/board.yml
```yaml
board:
  name: m5stack_timer_camera_x
  full_name: M5Stack Timer Camera X
  vendor: m5stack
  socs:
  - name: esp32
```
